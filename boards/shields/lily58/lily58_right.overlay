/*
 * Copyright (c) 2020 Pete Johanson
 *
 * SPDX-License-Identifier: MIT
 */

#include "lily58.dtsi"

&default_transform {
    col-offset = <6>;
};

&kscan0 {
    col-gpios
        = <&pro_micro 10 GPIO_ACTIVE_HIGH>
        , <&pro_micro 16 GPIO_ACTIVE_HIGH>
        , <&pro_micro 14 GPIO_ACTIVE_HIGH>
        , <&pro_micro 15 GPIO_ACTIVE_HIGH>
        , <&pro_micro 18 GPIO_ACTIVE_HIGH>
        , <&pro_micro 19 GPIO_ACTIVE_HIGH>
        ;
};

&pro_micro_i2c {
    status = "okay";
    clock-frequency = < 400000 >;
    cirque: cirque@2a {
        compatible = "cirque,pinnacle";
        reg = <0x2a>;
        status = "okay";
        dr-gpios = <&gpio0 0 (GPIO_ACTIVE_HIGH)>; // 이부분 나이스 나노의 006핀 gpio 내거랑 일치했다
        sensitivity = "2x";
        sleep;
        no-taps;
    };
   };

/ {
  cirque_listener {
    compatible = "zmk,input-listener";
    device = <&cirque>;
    y-invert;
    scale-multiplier = <5>;
    scale-divisor = <1>;
  };

