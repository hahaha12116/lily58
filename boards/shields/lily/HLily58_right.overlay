#include "HLily58.dtsi" // Notice that the main dtsi files are included in the overlay.

&default_transform { // The matrix transform for this board is 6 columns over because the left half is 5 columns wide according to the matrix.
    col-offset = <6>;
};

&kscan0 {
    col-gpios
        = <&gpio0 02 GPIO_ACTIVE_HIGH> // col6 in the schematic
        , <&gpio1 15 GPIO_ACTIVE_HIGH> // col7 in the schematic
        , <&gpio1 13 GPIO_ACTIVE_HIGH> // col8 in the schematic
        , <&gpio1 11 GPIO_ACTIVE_HIGH> // col9 in the schematic
        , <&gpio0 10 GPIO_ACTIVE_HIGH> // col10 in the schematic
        , <&gpio0 09 GPIO_ACTIVE_HIGH> // col11 in the schematic
        ;
};

// 이부분 수정해야할거같은데
&pro_micro_i2c {
    status = "okay";
    glidepoint: glidepoint@2a {
        status = "okay";
    };
};

/* &i2c0_default {
    group1 {
      bias-pull-up;
    };
}; */