## boards/shields/lily/Kconfig.shield
```kconfig
config SHIELD_ERGOTHWACK_LEFT
    def_bool $(shields_list_contains,HLily58_left)

config SHIELD_ERGOTHWACK_RIGHT
    def_bool $(shields_list_contains,HLily58_right)
```

## config/west.yml
```yaml
manifest:
  remotes:
    - name: zmkfirmware
      url-base: https://github.com/zmkfirmware
    - name: petejohanson
      url-base: https://github.com/petejohanson
    - name: urob
      url-base: https://github.com/urob
  projects:
    - name: zmk
      remote: urob
      revision: mouse-3.2
      import: app/west.yml
    - name: cirque-input-module
      remote: petejohanson
      revision: main
  self:
    path: config
```
